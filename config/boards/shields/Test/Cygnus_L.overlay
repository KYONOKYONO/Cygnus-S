#include "Cygnus.dtsi"

&kscan0 {
        col-gpios
            = <&xiao_d 10 GPIO_ACTIVE_HIGH>
            , <&xiao_d 9 GPIO_ACTIVE_HIGH> 
            , <&xiao_d 8 GPIO_ACTIVE_HIGH> 
            , <&xiao_d 7 GPIO_ACTIVE_HIGH> 
            , <&gpio0 10 GPIO_ACTIVE_HIGH>
            , <&gpio0 9 GPIO_ACTIVE_HIGH>
            ;
};

&left_encoder {
    status = "okay";
};

/ {
    /* ─── オートマウスレイヤー（AML）の機能定義 ─── */
    zip_temp_layer: zip_temp_layer {
        compatible = "zmk,input-processor-temp-layer";
        #input-processor-cells = <2>;
        
        /* 誤爆防止：200msの保護 */
        require-prior-idle-ms = <200>;
        
        /* マウスキーを押したときはレイヤーを維持するキーポジション */
        excluded-positions = <18 19 20 21 30 31 32 33>;
    };
};
